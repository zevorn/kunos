## conf/distro/k230-linux.conf
```bitbake
# SPDX-License-Identifier: MIT

require conf/distro/poky.conf

DISTRO = "k230-linux"
DISTRO_NAME = "K230 RISC-V Linux"
DISTRO_VERSION = "1.0"

PACKAGE_CLASSES = "package_ipk"
EXTRA_IMAGE_FEATURES ?= "allow-empty-password empty-root-password allow-root-login"

DISTRO_FEATURES:append = " ipv4 ipv6 largefile nfs pam usrmerge"
DISTRO_FEATURES:remove = "ptest"
BAD_RECOMMENDATIONS += "openssh-sftp-server"

VIRTUAL-RUNTIME_init_manager ?= "busybox"
VIRTUAL-RUNTIME_initscripts ?= "initscripts"
VIRTUAL-RUNTIME_login_manager ?= "busybox"
VIRTUAL-RUNTIME_syslog ?= "sysklogd"
```

## conf/layer.conf
```bitbake
BBPATH .= ":${LAYERDIR}"

BBFILES += "${LAYERDIR}/recipes-*/*/*.bb \
              ${LAYERDIR}/recipes-*/*/*.bbappend"

BBFILE_COLLECTIONS += "k230"
BBFILE_PATTERN_k230 = "^${LAYERDIR}/"
BBFILE_PRIORITY_k230 = "6"

LAYERDEPENDS_k230 = "riscv-layer"
LAYERSERIES_COMPAT_k230 = "scarthgap"
```

## wic/k230-canmv-sdimage.wks
```
# SPDX-License-Identifier: MIT

part /boot --source bootimg-partition --ondisk mmcblk1 --fstype=vfat --label boot --active --align 4096 --size 64
part / --source rootfs --ondisk mmcblk1 --fstype=ext4 --label root --align 4096 --size 512

bootloader --ptable msdos --timeout=0
```
